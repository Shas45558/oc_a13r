## kernel/sched/extension/Kconfig
```kconfig
menu "MTK scheduler extension"

config MTK_SCHED_EXTENSION
	bool "mtk scheduler extension"
	help
	  MTK scheduler extension,
	  1. include MTK scheduler enhancement.
	  2. All MTK scheduler sub-feature config should depend on
	     this config.
	  Say Y to enable MTK scheduler extension. If unsure, say N.

config MTK_SCHED_INTEROP
	bool "mtk scheduling interopation enhancement"
	depends on MTK_SCHED_EXTENSION
	help
	   Original Linux Design, RT & CFS do load balance seperatedly,
	   and let would result in unload balance.
	   that is, one CPU has more than 2 tasks, however, one CPU is IDLE
	   We make RT & CFS to check each other and make load more balance.

config MTK_SCHED_LB_ENHANCEMENT
	bool "mtk enhancement for load balance"
	depends on MTK_SCHED_EXTENSION && ENERGY_MODEL && CPU_FREQ_GOV_SCHEDUTIL
	help
	   mtk enhancement for load balance
	   system overutilization,
	   intra-cluster load balance,
	   and so on.

endmenu
```
